## kernel/opt/EmbedSky/kernel-2.6.13/drivers/video/logo/Kconfig
```kconfig
#
# Logo configuration
#

menu "Logo configuration"

config LOGO
	bool "Bootup logo"
	depends on FB || SGI_NEWPORT_CONSOLE

config LOGO_LINUX_MONO
	bool "Standard black and white Linux logo"
	depends on LOGO
	default y

config LOGO_LINUX_VGA16
	bool "Standard 16-color Linux logo"
	depends on LOGO
	default y

config LOGO_LINUX_CLUT224
	bool "Standard 224-color Linux logo"
	depends on LOGO && FB_S3C24X0_S320240 || FB_S3C24X0_W320240
	default y

config LOGO_LINUX_TFT70_CLUT224
	bool "Standard 224-color Linux logo for TFT70"
	depends on LOGO && FB_S3C24X0_TFT800480 
	default y

config LOGO_LINUX_VGA_CLUT224
	bool "Standard 224-color Linux logo for VGA"
	depends on LOGO && FB_S3C24X0_TFT640480 
	default y

config LOGO_LINUX_T35_CLUT224
	bool "Standard 224-color Linux logo for T35"
	depends on LOGO && FB_S3C24X0_T240320 
	default y

config LOGO_DEC_CLUT224
	bool "224-color Digital Equipment Corporation Linux logo"
	depends on LOGO && (MACH_DECSTATION || ALPHA)
	default y

config LOGO_MAC_CLUT224
	bool "224-color Macintosh Linux logo"
	depends on LOGO && MAC
	default y

config LOGO_PARISC_CLUT224
	bool "224-color PA-RISC Linux logo"
	depends on LOGO && PARISC
	default y

config LOGO_SGI_CLUT224
	bool "224-color SGI Linux logo"
	depends on LOGO && (SGI_IP22 || SGI_IP27 || SGI_IP32 || X86_VISWS)
	default y

config LOGO_SUN_CLUT224
	bool "224-color Sun Linux logo"
	depends on LOGO && (SPARC32 || SPARC64)
	default y

config LOGO_SUPERH_MONO
	bool "Black and white SuperH Linux logo"
	depends on LOGO && SUPERH
	default y

config LOGO_SUPERH_VGA16
	bool "16-color SuperH Linux logo"
	depends on LOGO && SUPERH
	default y

config LOGO_SUPERH_CLUT224
	bool "224-color SuperH Linux logo"
	depends on LOGO && SUPERH
	default y

config LOGO_M32R_CLUT224
	bool "224-color M32R Linux logo"
	depends on LOGO && M32R
	default y

endmenu
```
